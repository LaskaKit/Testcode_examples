## Displays/E-Paper/7-09/GDEB0709E01/GoodDisplay/ESP-IDF/gdeb0709e01_demo/sdkconfig.defaults
```kconfig
# GDEB0709E01 ESP32-S3
# ESP-IDF 5.4.x

CONFIG_PARTITION_TABLE_CUSTOM=y
CONFIG_PARTITION_TABLE_CUSTOM_FILENAME="partitions.csv"
CONFIG_PARTITION_TABLE_OFFSET=0x8000

CONFIG_SPI_MASTER_IN_IRAM=y
CONFIG_COMPILER_OPTIMIZATION_SIZE=y
```
